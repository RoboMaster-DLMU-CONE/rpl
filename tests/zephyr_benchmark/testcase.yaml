## tests/zephyr_benchmark/testcase.yaml
```yaml
tests:
  rpl.benchmark.cortex_m:
    tags: benchmark rpl
    platform_allow: qemu_cortex_m3
```

## west.yml
```yaml
manifest:
  version: "1.2"

  defaults:
    remote: origin

  remotes:
    - name: zephyrproject-rtos
      url-base: https://github.com/zephyrproject-rtos
    - name: origin
      url-base: https://github.com/RoboMaster-DLMU-CONE

  projects:
    - name: zephyr
      remote: zephyrproject-rtos
      revision: main
    - name: rpl
      repo-path: rpl
      path: modules/lib/rpl
      revision: main

  self:
    path: modules/lib/rpl
```

## zephyr/Kconfig
```kconfig
config RPL
    bool "RoboMaster Packet Library support"
    select CPP
    select REQUIRES_FULL_LIBCPP
    help
      Enable RoboMaster Packet Library for multi-platform communication.

if RPL

endif # RPL
```
